VERSION ""

NS_ :

BS_:

BU_: XXX 3

BO_ 36 NEW_MSG_1: 8 XXX
 SG_ NEW_SIGNAL_1 : 28|13@0+ (1,0) [0|16383] "" XXX
