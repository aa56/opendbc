VERSION ""

NS_ :

BS_:

BU_: XXX 3

BO_ 36 NEW_MSG_1: 8 XXX
 SG_ NEW_SIGNAL_1 : 28|13@0+ (1,0) [0|16383] "" XXX

BO_ 176 RPM: 8 XXX
 SG_ Engine Speed : 20|13@0+ (1,0) [0|8191] "TBD" XXX

CM_ SG_ 176 Engine Speed "Tentative";
